## device_defconfig
```kconfig
CONFIG_INPUT=y
CONFIG_INPUT_EVDEV=y
CONFIG_INPUT_TOUCHSCREEN=y
# CONFIG_INPUT_KEYBOARD is not set
# CONFIG_INPUT_MOUSE is not set
# CONFIG_INPUT_MOUSEDEV is not set
CONFIG_I2C=y
CONFIG_DEBUG_FS=y

#CONFIG_TOUCHSCREEN_ARIES_ATMEL_MXT=y
CONFIG_ARIES_RMI4_BUS=y
CONFIG_ARIES_RMI4_DEBUG=y
CONFIG_ARIES_RMI4_FWLIB=y
CONFIG_ARIES_RMI4_I2C=y
# CONFIG_ARIES_RMI4_SMB is not set
CONFIG_ARIES_RMI4_GENERIC=y
CONFIG_ARIES_RMI4_F1A=y
# CONFIG_ARIES_RMI4_F09 is not set
CONFIG_ARIES_RMI4_F11=y
# CONFIG_ARIES_RMI4_F11_PEN is not set
CONFIG_ARIES_RMI4_F11_TYPEB=y
# CONFIG_ARIES_RMI4_VIRTUAL_BUTTON is not set
# CONFIG_ARIES_RMI4_F17 is not set
# CONFIG_ARIES_RMI4_F19 is not set
# CONFIG_ARIES_RMI4_F21 is not set
# CONFIG_ARIES_RMI4_F30 is not set
# CONFIG_ARIES_RMI4_F34 is not set
# CONFIG_ARIES_RMI4_F41 is not set
CONFIG_ARIES_RMI4_F54=y
```

## lkl/Kconfig
```kconfig
config TOUCHSCREEN_ARIES_ATMEL_MXT
	tristate "Atmel mXT I2C Touchscreen"
	depends on I2C
	select FW_LOADER
	help
	  Say Y here if you have Atmel mXT series I2C touchscreen,
	  such as AT42QT602240/ATMXT224, connected to your system.

	  If unsure, say N.

	  To compile this driver as a module, choose M here: the
	  module will be called atmel_mxt_ts.

source "drivers/efidroid/device/xiaomi/aries/lkl/rmi4/Kconfig"
```
